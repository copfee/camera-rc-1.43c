## components/ui/Kconfig.projbuild
```kconfig
menu "Camera remote UI"

choice RC_SHUTTER_STYLE
    prompt "Shutter button style"
    default RC_SHUTTER_STYLE_MODEL

config RC_SHUTTER_STYLE_MODEL
    bool "FUJIFILM"

config RC_SHUTTER_STYLE_DRAGON
    bool "Dragon"
endchoice

endmenu
```

## sdkconfig.defaults
```kconfig
CONFIG_IDF_TARGET="esp32s3"
CONFIG_ESPTOOLPY_FLASHMODE_QIO=y
CONFIG_ESPTOOLPY_FLASHSIZE_8MB=y
CONFIG_PARTITION_TABLE_CUSTOM=y
CONFIG_PARTITION_TABLE_CUSTOM_FILENAME="partitions.csv"
CONFIG_SPIRAM=y
CONFIG_SPIRAM_MODE_OCT=y
CONFIG_SPIRAM_SPEED_80M=y
CONFIG_ESP_DEFAULT_CPU_FREQ_MHZ_240=y
CONFIG_FREERTOS_HZ=1000
CONFIG_ESP_CONSOLE_USB_SERIAL_JTAG=y
CONFIG_BT_ENABLED=y
CONFIG_BT_NIMBLE_ENABLED=y
CONFIG_BT_NIMBLE_ROLE_CENTRAL=y
CONFIG_BT_NIMBLE_ROLE_OBSERVER=y
CONFIG_BT_NIMBLE_MAX_CONNECTIONS=1
CONFIG_BT_NIMBLE_SM_SC=y
CONFIG_BT_NIMBLE_NVS_PERSIST=y
CONFIG_LV_COLOR_DEPTH_16=y
# Shared display/animation cadence: about 60 Hz while areas are invalidated.
CONFIG_LV_DEF_REFR_PERIOD=16
CONFIG_LV_USE_CLIB_MALLOC=y
CONFIG_LV_USE_CLIB_STRING=y
CONFIG_LV_USE_CLIB_SPRINTF=y
CONFIG_LV_USE_THEME_DEFAULT=n
CONFIG_LV_FONT_MONTSERRAT_20=y
CONFIG_LV_FONT_MONTSERRAT_28=y
CONFIG_COMPILER_CXX_EXCEPTIONS=n
CONFIG_COMPILER_CXX_RTTI=n

CONFIG_LV_FONT_MONTSERRAT_48=y
CONFIG_LV_BUILD_EXAMPLES=n
CONFIG_LV_BUILD_DEMOS=n

# Do not delete existing bonds or auto-repair keys behind the owner state machine.
CONFIG_BT_NIMBLE_HANDLE_REPEAT_PAIRING_DELETION=n
CONFIG_BT_NIMBLE_GATTC_AUTO_PAIR=n
```
